## CMakeLists.txt
```
cmake_minimum_required(VERSION 3.20.0)

find_package(Zephyr REQUIRED HINTS $ENV{ZEPHYR_BASE})
project(test_model)

# These samples use local static initialization. Since Zephyr doesn't support the
# C++ ABI for thread-safe initialization of local statics and the constructors don't
# appear to require thread safety, we turn it off in the C++ compiler.
set(NO_THREADSAFE_STATICS $<TARGET_PROPERTY:compiler-cpp,no_threadsafe_statics>)
zephyr_compile_options($<$<COMPILE_LANGUAGE:CXX>:${NO_THREADSAFE_STATICS}>)

file(GLOB app_sources src/*)
target_sources(app PRIVATE ${app_sources})
```

## prj.conf
```kconfig
CONFIG_CPP=y
CONFIG_STD_CPP17=y
CONFIG_TENSORFLOW_LITE_MICRO=y
CONFIG_MAIN_STACK_SIZE=2048
CONFIG_REQUIRES_FLOAT_PRINTF=y
```

## src/main.c
```c
#include "main_functions.h"

int main(int argc, char *argv[])
{
	setup();
    while(1){
        loop();
    }
}
```

## src/constants.c
```c
/*
 * Copyright 2020 The TensorFlow Authors. All Rights Reserved.
 *
 * Licensed under the Apache License, Version 2.0 (the "License");
 * you may not use this file except in compliance with the License.
 * You may obtain a copy of the License at
 *
 *     http://www.apache.org/licenses/LICENSE-2.0
 *
 * Unless required by applicable law or agreed to in writing, software
 * distributed under the License is distributed on an "AS IS" BASIS,
 * WITHOUT WARRANTIES OR CONDITIONS OF ANY KIND, either express or implied.
 * See the License for the specific language governing permissions and
 * limitations under the License.
 */

#include "constants.h"

/* This is a small number so that it's easy to read the logs */
const int kTensorArenaSize = 32000;
```

## src/constants.h
```c
#ifndef CONSTANTS_H_
#define CONSTANTS_H_

// Tensor arena
const int kTensorArenaSize = 32000;

// Input MNIST: 28x28, int8 quant
const int kImageSize = 28 * 28;
const float kInputScale = 0.0039215689f;   // ~1/255
const int kInputZeroPoint = -128;

// Output: 10 lớp (digit 0-9)
const int kNumClasses = 10;
const float kOutputScale = 0.00390625f;
const int kOutputZeroPoint = -128;

#endif  // CONSTANTS_H_
```

## src/main_functions.cpp
```c
#include "main_functions.h"
#include "constants.h"
#include "output_handler.hpp"
#include "model-LeNet.h"

#include <tensorflow/lite/micro/micro_mutable_op_resolver.h>
#include <tensorflow/lite/micro/micro_interpreter.h>
#include <tensorflow/lite/micro/micro_log.h>
#include <tensorflow/lite/schema/schema_generated.h>

#include <zephyr/kernel.h>   // để dùng k_cycle_get_32 và k_sleep

namespace {
  const tflite::Model* model = nullptr;
  tflite::MicroInterpreter* interpreter = nullptr;
  TfLiteTensor* input = nullptr;
  TfLiteTensor* output = nullptr;

  uint8_t tensor_arena[kTensorArenaSize];
}  // namespace


void setup(void) {
  MicroPrintf("Setup TFLM LeNet (quant int8)");

  model = tflite::GetModel(model_LeNet_quant);
  if (model->version() != TFLITE_SCHEMA_VERSION) {
    MicroPrintf("Model provided is schema version %d not equal "
                "to supported version %d.",
                model->version(), TFLITE_SCHEMA_VERSION);
    return;
  }

  static tflite::MicroMutableOpResolver<7> resolver;
  resolver.AddPad();
  resolver.AddConv2D();
  resolver.AddAveragePool2D();
  resolver.AddTanh();
  resolver.AddReshape();
  resolver.AddFullyConnected();
  resolver.AddSoftmax();

  static tflite::MicroInterpreter static_interpreter(
      model, resolver, tensor_arena, kTensorArenaSize);
  interpreter = &static_interpreter;

  if (interpreter->AllocateTensors() != kTfLiteOk) {
    MicroPrintf("AllocateTensors() failed");
    return;
  }

  input  = interpreter->input(0);
  output = interpreter->output(0);

  MicroPrintf("Setup done. input bytes=%d, output bytes=%d", input->bytes, output->bytes);
}


void loop(void) {

  uint32_t start = k_cycle_get_32();
  TfLiteStatus invoke_status = interpreter->Invoke();
	if (invoke_status != kTfLiteOk) {
		MicroPrintf("Invoke failed");
		return;
	}

  uint32_t end = k_cycle_get_32();

  uint64_t duration_ns = k_cyc_to_ns_floor64(end - start);

  MicroPrintf("Inference time = %llu us", duration_ns / 1000);

}
```

## src/model-LeNet.h
```c
#ifndef MODEL_LENET_H
#define MODEL_LENET_H


extern const unsigned char model_LeNet_quant[];
extern unsigned int model_LeNet_quant_len;    



#endif // MODEL_RESSNET_H
```

## src/output_handler.cpp
```c
// output_handler.cpp
#include "output_handler.hpp"
#include <tensorflow/lite/micro/micro_log.h>
#include <cmath>
#include "constants.h"

// In probabilities & Top-1 từ tensor output (int8, shape [1,10])
void HandleOutput(const int8_t* output_data, int length) {
    int predicted = -1;
    float max_val = -1e9;

    for (int i = 0; i < length; i++) {
        float val = kOutputScale * (output_data[i] - kOutputZeroPoint);
        MicroPrintf("Class %d = %f", i, static_cast<double>(val));

        if (val > max_val) {
            max_val = val;
            predicted = i;
        }
    }

    MicroPrintf("Predicted digit = %d", predicted);
}
```

## src/output_handler.hpp
```c
#ifndef OUTPUT_HANDLER_HPP
#define OUTPUT_HANDLER_HPP

#include <tensorflow/lite/c/common.h>

void HandleOutput(const int8_t* output_data, int length);

#endif  // OUTPUT_HANDLER_HPP
```

## src/test_image.cpp
```c
#include "test_image.h"

// ví dụ ảnh số "3"
const uint8_t test_image[28*28] = {
  0,0,0,0,0,0,0,0,0,0,0,0,0,0,0,0,0,0,0,0,0,0,0,0,0,0,0,0,
  0,0,0,0,0,0,0,0,0,0,0,0,0,0,0,0,0,0,0,0,0,0,0,0,0,0,0,0,
  0,0,0,0,0,0,0,0,0,0,0,0,0,0,0,0,0,0,0,0,0,0,0,0,0,0,0,0,
  0,0,0,0,0,0,0,0,0,0,0,0,0,0,0,0,0,0,0,0,0,0,0,0,0,0,0,0,
  0,0,0,0,0,0,0,0,0,0,0,0,0,0,0,0,0,0,0,0,0,0,0,0,0,0,0,0,
  0,0,0,0,0,0,0,0,0,0,0,0,0,0,0,0,0,0,0,0,0,0,0,0,0,0,0,0,
  0,0,0,0,0,0,255,255,255,255,255,255,255,255,255,255,255,255,255,255,255,0,0,0,0,0,0,0,
  0,0,0,0,255,255,255,255,255,255,255,255,255,255,255,255,255,255,255,255,255,255,255,0,0,0,0,0,
  0,0,0,255,255,255,255,255,255,255,255,255,255,255,255,255,255,255,255,255,255,255,255,255,0,0,0,0,
  0,0,255,255,255,255,255,255,255,0,0,0,0,0,0,0,0,0,255,255,255,255,255,255,255,0,0,0,
  0,0,255,255,255,255,255,255,0,0,0,0,0,0,0,0,0,0,0,255,255,255,255,255,255,0,0,0,
  0,0,0,0,0,0,0,0,0,0,0,0,0,0,0,0,0,0,0,255,255,255,255,255,255,0,0,0,
  0,0,0,0,0,0,0,0,0,0,0,0,0,0,0,0,0,0,255,255,255,255,255,255,0,0,0,0,
  0,0,0,0,0,0,0,0,0,0,0,0,0,0,0,255,255,255,255,255,255,255,255,0,0,0,0,0,
  0,0,0,0,0,0,0,0,0,0,255,255,255,255,255,255,255,255,255,255,255,255,0,0,0,0,0,0,
  0,0,0,0,0,0,0,0,0,0,255,255,255,255,255,255,255,255,255,255,255,255,0,0,0,0,0,0,
  0,0,0,0,0,0,0,0,0,0,255,255,255,255,255,255,255,255,255,255,255,255,255,0,0,0,0,0,
  0,0,0,0,0,0,0,0,0,0,0,0,0,0,0,0,0,0,255,255,255,255,255,255,0,0,0,0,
  0,0,0,0,0,0,0,0,0,0,0,0,0,0,0,0,0,0,0,255,255,255,255,255,255,0,0,0,
  0,0,0,0,0,0,0,0,0,0,0,0,0,0,0,0,0,0,0,255,255,255,255,255,255,0,0,0,
  0,0,255,255,255,255,255,255,0,0,0,0,0,0,0,0,0,0,0,255,255,255,255,255,255,0,0,0,
  0,0,255,255,255,255,255,255,255,0,0,0,0,0,0,0,0,0,255,255,255,255,255,255,255,0,0,0,
  0,0,0,255,255,255,255,255,255,255,255,255,255,255,255,255,255,255,255,255,255,255,255,255,0,0,0,0,
  0,0,0,0,255,255,255,255,255,255,255,255,255,255,255,255,255,255,255,255,255,255,255,0,0,0,0,0,
  0,0,0,0,0,0,255,255,255,255,255,255,255,255,255,255,255,255,255,255,255,0,0,0,0,0,0,0,
  0,0,0,0,0,0,0,0,0,0,0,0,0,0,0,0,0,0,0,0,0,0,0,0,0,0,0,0,
  0,0,0,0,0,0,0,0,0,0,0,0,0,0,0,0,0,0,0,0,0,0,0,0,0,0,0,0,
  0,0,0,0,0,0,0,0,0,0,0,0,0,0,0,0,0,0,0,0,0,0,0,0,0,0,0,0
};
```

## src/test_image.h
```c
// test_image.h
#ifndef TEST_IMAGE_H_
#define TEST_IMAGE_H_

#include <stdint.h>   // hoặc <cstdint>

extern const uint8_t test_image[28*28];

#endif  // TEST_IMAGE_H_
```
