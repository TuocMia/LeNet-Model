## build/Kconfig/arch/Kconfig
```kconfig
# Load Zephyr Arch Kconfig descriptions.
osource "/home/tuocmia/zephyrproject/zephyr/arch/rx/Kconfig"
osource "/home/tuocmia/zephyrproject/zephyr/arch/x86/Kconfig"
osource "/home/tuocmia/zephyrproject/zephyr/arch/xtensa/Kconfig"
osource "/home/tuocmia/zephyrproject/zephyr/arch/sparc/Kconfig"
osource "/home/tuocmia/zephyrproject/zephyr/arch/riscv/Kconfig"
osource "/home/tuocmia/zephyrproject/zephyr/arch/posix/Kconfig"
osource "/home/tuocmia/zephyrproject/zephyr/arch/nios2/Kconfig"
osource "/home/tuocmia/zephyrproject/zephyr/arch/mips/Kconfig"
osource "/home/tuocmia/zephyrproject/zephyr/arch/arm64/Kconfig"
osource "/home/tuocmia/zephyrproject/zephyr/arch/arm/Kconfig"
osource "/home/tuocmia/zephyrproject/zephyr/arch/arc/Kconfig"
```

## build/Kconfig/boards/Kconfig
```kconfig
# Load Zephyr board Kconfig descriptions.
osource "/home/tuocmia/zephyrproject/zephyr/boards/espressif/esp_wrover_kit/Kconfig"
```

## build/Kconfig/boards/Kconfig.defconfig
```kconfig
# Load Zephyr board defconfig descriptions.
osource "/home/tuocmia/zephyrproject/zephyr/boards/espressif/esp_wrover_kit/Kconfig.defconfig"
```

## build/Kconfig/boards/Kconfig.esp_wrover_kit
```kconfig
# Load board Kconfig descriptions.
osource "/home/tuocmia/zephyrproject/zephyr/boards/espressif/esp_wrover_kit/Kconfig.esp_wrover_kit"
```

## build/Kconfig/boards/Kconfig.sysbuild
```kconfig
# Load Sysbuild board Kconfig descriptions.
osource "C:/Users/admin/zephyrproject/external/zephyr/boards/espressif/esp_wrover_kit/Kconfig.sysbuild"
```
